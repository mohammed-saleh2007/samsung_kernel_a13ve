## drivers/sensorhub/debug/Kconfig
```kconfig
config SHUB_DEBUG
    tristate "Sensor hub debug mode"
    default n
    help
      If you want to use debug mode for the sensor hub, it should be set.
```

## drivers/sensorhub/sensorhub/Kconfig
```kconfig
config SHUB_MODULE
    tristate "SHUB module"
    default n

config SHUB_FIRMWARE_DOWNLOAD
    tristate "Sensor hub firmware download"
    default n

config SHUB_AP_STATUS_CMD
    tristate "Sensor hub AP status command"
    default n
    help
      If you say yes, send command to sensor hub when AP suspends or resumes.

config SHUB_SPU
    tristate "Sensor hub SPU firmware download"
    default n
```
